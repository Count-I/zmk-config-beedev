## config/boards/shields/beedev/Kconfig.defconfig
```kconfig
if SHIELD_beedev_LEFT

config ZMK_KEYBOARD_NAME
    default "beedev"

config ZMK_SPLIT_ROLE_CENTRAL
    default y

endif

if SHIELD_beedev_LEFT || SHIELD_beedev_RIGHT

config ZMK_SPLIT
    default y

endif
```

## config/boards/shields/beedev/Kconfig.shield
```kconfig
config SHIELD_beedev_LEFT
    def_bool $(shields_list_contains,beedev_left)

config SHIELD_beedev_RIGHT
    def_bool $(shields_list_contains,beedev_right)
```
